## config/west.yml
```yaml
manifest:
  remotes:
      # zmk official
    - name: zmkfirmware
      url-base: https://github.com/zmkfirmware
    - name: irbaboon2o                         #new entry
      url-base: https://github.com/irbaboon2o  #new entry
  projects:
    - name: zmk
      remote: zmkfirmware
      revision: main
      import: app/west.yml
    - name: hammerbeam-slideshow          #new entry
      remote: irbaboon2o                       #new entry
      revision: main                      #new entry
  self:
    path: config
```
